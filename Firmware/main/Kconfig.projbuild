## Firmware/main/Kconfig.projbuild
```kconfig
menu "Linkey Monitor Configuration"

    config LINKEY_DEVICE_NAME
        string "Device Name"
        default "Linkey"
        help
            Device name shown in Home Assistant.

    config LINKEY_MQTT_BROKER_URI
        string "MQTT Broker URI"
        default "mqtt://homeassistant.local:1883"
        help
            Fallback URI of the MQTT broker to connect to.
            Example: mqtt://192.168.1.100 or mqtts://mqtt.example.com

    config LINKEY_MQTT_AUTODISCOVERY
        bool "Auto-discover MQTT broker with mDNS"
        default y
        help
            Query Home Assistant _home-assistant._tcp.local and use port 1883
            on the discovered host.
            If discovery fails, the firmware falls back to LINKEY_MQTT_BROKER_URI.

    config LINKEY_MQTT_USERNAME
        string "MQTT Username"
        default ""
        help
            Username for MQTT broker authentication.
            Leave empty to use the runtime default linkey_<last 6 hex digits
            of the WiFi MAC address>, for example linkey_8ebde0.

    config LINKEY_MQTT_PASSWORD
        string "MQTT Password"
        default ""
        help
            Optional development override for the MQTT password.
            Leave empty to use the fallback defined in factory_config_schema.h,
            or the per-device value from the factory_data partition when present.

    config LINKEY_PROV_POP
        string "Provisioning Proof of Possession"
        default ""
        help
            Optional development override for the Espressif provisioning PoP.
            Leave empty to use the fallback defined in factory_config_schema.h,
            or the per-device value from the factory_data partition when present.

    config LINKEY_USE_STATIC_IP
        bool "Use Static IP (faster connection)"
        default n
        help
            Use static IP instead of DHCP for faster initial connection.

    config LINKEY_STATIC_IP
        string "Static IP Address"
        default "192.168.1.200"
        depends on LINKEY_USE_STATIC_IP
        help
            Static IP address to use.

    config LINKEY_STATIC_GATEWAY
        string "Gateway Address"
        default "192.168.1.1"
        depends on LINKEY_USE_STATIC_IP
        help
            Gateway IP address.

    config LINKEY_STATIC_NETMASK
        string "Netmask"
        default "255.255.255.0"
        depends on LINKEY_USE_STATIC_IP
        help
            Network mask.

    choice LINKEY_TARIFF_OPTION
        prompt "Tariff Option"
        default LINKEY_TARIFF_BASE
        help
            Select the Linky tariff option to determine which energy
            index labels are parsed and published.

        config LINKEY_TARIFF_BASE
            bool "BASE"

        config LINKEY_TARIFF_HPHC
            bool "HPHC"

        config LINKEY_TARIFF_EJP
            bool "EJP"

        config LINKEY_TARIFF_TEMPO
            bool "TEMPO"

    endchoice

    config LINKEY_DEBUG_LOGS
        bool "Enable debug logging"
        default n
        help
            Enable verbose debug logs for troubleshooting.
            Disable in production for cleaner logs.

endmenu
```

## Firmware/sdkconfig.defaults
```kconfig
# Enable ULP support
CONFIG_ULP_COPROC_ENABLED=y
CONFIG_ULP_COPROC_TYPE_FSM=y
CONFIG_ULP_COPROC_RESERVE_MEM=4096

# Enable power management (deep sleep and light sleep)
CONFIG_PM_ENABLE=y
CONFIG_FREERTOS_USE_TICKLESS_IDLE=y

# Disable IDLE task watchdog for light sleep compatibility
CONFIG_ESP_TASK_WDT_CHECK_IDLE_TASK_CPU0=n
CONFIG_ESP_TASK_WDT_CHECK_IDLE_TASK_CPU1=n

# WiFi settings
CONFIG_ESP_WIFI_STATIC_RX_BUFFER_NUM=4
CONFIG_ESP_WIFI_DYNAMIC_RX_BUFFER_NUM=8
CONFIG_ESP_WIFI_DYNAMIC_TX_BUFFER_NUM=8
CONFIG_ESP_WIFI_IRAM_OPT=n
CONFIG_ESP_WIFI_RX_IRAM_OPT=n

# Partition table
CONFIG_PARTITION_TABLE_SINGLE_APP_LARGE=y

# BLE provisioning support
CONFIG_BT_ENABLED=y
CONFIG_BT_BLE_ENABLED=y
CONFIG_BT_BLUEDROID_ENABLED=y
CONFIG_BT_CLASSIC_ENABLED=n
CONFIG_BTDM_CTRL_MODE_BLE_ONLY=y
CONFIG_BTDM_CTRL_MODE_BTDM=n

# MQTT settings
CONFIG_MQTT_PROTOCOL_311=y
CONFIG_MQTT_REPORT_DELETED_MESSAGES=y
CONFIG_MQTT_USE_CUSTOM_CONFIG=y
CONFIG_MQTT_OUTBOX_EXPIRED_TIMEOUT_MS=500

# Log level
CONFIG_LOG_DEFAULT_LEVEL_INFO=y
```
